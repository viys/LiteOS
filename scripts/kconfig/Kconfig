## scripts/kconfig/Kconfig
```kconfig
mainmenu "Template Project Configuration"

menu "Application Settings"

config APP_NAME
    string "Application name"
    default "my_app"
    help
        The name of the application, used in log output and version info.

config APP_VERSION_MAJOR
    int "Major version"
    default 1
    range 0 99
    help
        Major version number (X in X.Y.Z).

config APP_VERSION_MINOR
    int "Minor version"
    default 0
    range 0 99
    help
        Minor version number (Y in X.Y.Z).

config APP_VERSION_PATCH
    int "Patch version"
    default 0
    range 0 99
    help
        Patch version number (Z in X.Y.Z).

endmenu

menu "Debug Settings"

config DEBUG_ENABLE
    bool "Enable debug output"
    default n
    help
        Enable debug logging output at runtime.

if DEBUG_ENABLE

config DEBUG_LEVEL
    int "Debug level"
    default 1
    range 1 3
    help
        Controls verbosity of debug output.
        1 - Errors only
        2 - Warnings and errors
        3 - Verbose (all messages)

endif

endmenu
```
